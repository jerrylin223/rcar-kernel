// SPDX-License-Identifier: (GPL-2.0-only OR BSD-2-Clause)
/*
 * Device Tree Source for the R-Car V4H White Hawk board
 * Support Native RGID driver.
 *
 * Copyright (C) 2025 Renesas Electronics Corp.
 */

/dts-v1/;
#include "white-hawk-native-rgid.dtsi"
#include "r8a779g0-rgid.dtsi"
#include "white-hawk-cpu-common-rgid.dtsi"
#include "white-hawk-common-rgid.dtsi"
#include "white-hawk-native-common.dtsi"

/ {
	model = "Renesas White Hawk board based on r8a779g0";
	compatible = "renesas,whitehawk", "renesas,r8a779g0";
};
