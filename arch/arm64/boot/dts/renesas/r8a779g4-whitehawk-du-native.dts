// SPDX-License-Identifier: (GPL-2.0-only OR BSD-2-Clause)
/*
 * Device Tree Source for the R-Car V4H-5 White Hawk board
 * Support Native Linux display driver and 4 lane PCIe.
 *
 * Copyright (C) 2025 Renesas Electronics Corp.
 */

/dts-v1/;
#include "r8a779g4.dtsi"
#include "white-hawk-cpu-common.dtsi"
#include "white-hawk-common.dtsi"
#include "white-hawk-native-common.dtsi"
#include "whitehawk-du-native-common.dtsi"

/ {
	model = "Renesas White Hawk board based on r8a779g4";
	compatible = "renesas,whitehawk", "renesas,r8a779g0",
				"renesas,r8a779g4";
};
